## esp_port/examples/esp_camera/main/Kconfig.projbuild
```kconfig
menu "ESP WebRTC Camera Configuration"
    config APPRTC_SERVER_URL
        string "AppRTC server URL"
        default "https://webrtc.espressif.com"
        help
            URL of the AppRTC signaling server.

    config APPRTC_USE_FIXED_ROOM
        bool "Use fixed room ID"
        default n
        help
            If enabled, uses a fixed room ID instead of generating a random one.

    config APPRTC_ROOM_ID
        string "Fixed AppRTC room ID"
        default "esp32test"
        depends on APPRTC_USE_FIXED_ROOM
        help
            The fixed room ID to use when connecting to the AppRTC server.

    config APPRTC_ROLE_TYPE
        int "WebRTC role type"
        default 1
        range 0 1
        help
            Role type for the WebRTC connection.
            0: MASTER - Creates a room and waits for viewers to connect.
            1: VIEWER - Can create a room or join an existing one via CLI.

    config APPRTC_AUTO_CONNECT
        bool "Auto-connect to signaling server on startup"
        default y
        help
            If enabled, automatically connects to the signaling server on startup.
            If disabled, connection must be initiated manually via CLI commands.

    config APPRTC_LOG_VERBOSE
        bool "Enable verbose AppRTC logging"
        default n
        help
            Enable verbose logging for AppRTC signaling.
endmenu
```

## esp_port/examples/esp_camera/sdkconfig.defaults
```kconfig
# Streaming only defaults to P4
CONFIG_IDF_TARGET="esp32p4"
CONFIG_IDF_TARGET_ESP32P4=y

#
# Serial flasher config
#
CONFIG_ESPTOOLPY_FLASHMODE_QIO=y
CONFIG_ESPTOOLPY_FLASHFREQ_80M=y
CONFIG_ESPTOOLPY_FLASHSIZE_4MB=y

#
# Partition Table
#
CONFIG_PARTITION_TABLE_CUSTOM=y
CONFIG_PARTITION_TABLE_CUSTOM_FILENAME="partitions.csv"
CONFIG_PARTITION_TABLE_FILENAME="partitions.csv"
CONFIG_PARTITION_TABLE_OFFSET=0x8000

#
# Compiler options
#
CONFIG_COMPILER_OPTIMIZATION_SIZE=y

#
# ESP32-Specific
#
CONFIG_ESP32_DEFAULT_CPU_FREQ_240=y
CONFIG_ESP32_DEFAULT_CPU_FREQ_MHZ=240

#
# ESP-TLS
#
CONFIG_ESP_TLS_USING_MBEDTLS=y

#
# SPI RAM config
#
CONFIG_SPIRAM=y
CONFIG_SPIRAM_SUPPORT=y
CONFIG_SPIRAM_BOOT_INIT=y
CONFIG_ESP32_SPIRAM_SUPPORT=y
CONFIG_SPIRAM_RODATA=y
CONFIG_WIFI_LWIP_ALLOCATION_FROM_SPIRAM_FIRST=y

CONFIG_SPIRAM_USE_MALLOC=y
CONFIG_SPIRAM_MALLOC_ALWAYSINTERNAL=0
CONFIG_SPIRAM_TRY_ALLOCATE_WIFI_LWIP=y
CONFIG_SPIRAM_MALLOC_RESERVE_INTERNAL=16000
CONFIG_SPIRAM_ALLOW_BSS_SEG_EXTERNAL_MEMORY=y
CONFIG_SPIRAM_BANKSWITCH_ENABLE=y
CONFIG_SPIRAM_BANKSWITCH_RESERVE=8
CONFIG_SPIRAM_ALLOW_STACK_EXTERNAL_MEMORY=y
CONFIG_SPIRAM_SPEED_80M=y

CONFIG_ESP32_WIFI_STATIC_TX_BUFFER=y
CONFIG_ESP32_WIFI_TX_BUFFER_TYPE=0
CONFIG_ESP32_WIFI_STATIC_TX_BUFFER_NUM=16

CONFIG_FATFS_LFN_HEAP=y
CONFIG_FATFS_MAX_LFN=255
CONFIG_FATFS_API_ENCODING_ANSI_OEM=y
CONFIG_FATFS_FS_LOCK=10

CONFIG_FATFS_ALLOC_PREFER_EXTRAM=y

CONFIG_LOG_DEFAULT_LEVEL=3

#
# SNTP
#
CONFIG_LWIP_SNTP_MAX_SERVERS=3

#
# LWIP
#
CONFIG_LWIP_MAX_SOCKETS=10
CONFIG_LWIP_DHCP_MAX_NTP_SERVERS=1
CONFIG_LWIP_L2_TO_L3_COPY=y
CONFIG_TCP_SND_BUF_DEFAULT=65534
CONFIG_TCP_WND_DEFAULT=65535
CONFIG_TCP_RECVMBOX_SIZE=64
CONFIG_LWIP_TCP_SND_BUF_DEFAULT=65534
CONFIG_LWIP_TCP_WND_DEFAULT=65535
CONFIG_LWIP_TCP_RECVMBOX_SIZE=64

#
# mbedTLS
#
CONFIG_MBEDTLS_EXTERNAL_MEM_ALLOC=y

#CONFIG_SEMIHOSTFS_MAX_MOUNT_POINTS=1
#CONFIG_SEMIHOSTFS_HOST_PATH_MAX_LEN=128

CONFIG_MBEDTLS_SSL_PROTO_DTLS=y
CONFIG_MBEDTLS_SSL_ALPN=y

# mbedtls dynamic buffer for memory optimization
CONFIG_MBEDTLS_ASYMMETRIC_CONTENT_LEN=y

CONFIG_MBEDTLS_SSL_VARIABLE_BUFFER_LENGTH=n
CONFIG_MBEDTLS_DYNAMIC_BUFFER=y
CONFIG_MBEDTLS_DYNAMIC_FREE_CONFIG_DATA=y
CONFIG_MBEDTLS_DYNAMIC_FREE_CA_CERT=y
CONFIG_MBEDTLS_DYNAMIC_FREE_PEER_CERT=y

#
# ESP Ringbuf
#
CONFIG_RINGBUF_PLACE_FUNCTIONS_INTO_FLASH=y
CONFIG_RINGBUF_PLACE_ISR_FUNCTIONS_INTO_FLASH=y

#
# FreeRTOS
#
CONFIG_FREERTOS_PLACE_SNAPSHOT_FUNS_INTO_FLASH=y
CONFIG_FREERTOS_CHECK_STACKOVERFLOW_CANARY=y
CONFIG_SYSTEM_EVENT_TASK_STACK_SIZE=4096

#
# ESP System Settings
#
CONFIG_ESP_SYSTEM_ALLOW_RTC_FAST_MEM_AS_HEAP=y

#
# PThreads
#
CONFIG_PTHREAD_TASK_STACK_SIZE_DEFAULT=8000
CONFIG_PTHREAD_STACK_MIN=4096


CONFIG_MAIN_TASK_STACK_SIZE=8192
CONFIG_IPC_TASK_STACK_SIZE=1024
CONFIG_TIMER_TASK_STACK_SIZE=3584

CONFIG_MB_SERIAL_TASK_STACK_SIZE=2048
CONFIG_SUPPORT_STATIC_ALLOCATION=y

#
# Wi-Fi
#
# CONFIG_ESP32_WIFI_STATIC_RX_BUFFER_NUM=16
CONFIG_ESP32_WIFI_IRAM_OPT=n
CONFIG_ESP32_WIFI_RX_IRAM_OPT=n

CONFIG_ESP_SYSTEM_EVENT_TASK_STACK_SIZE=4000

CONFIG_ESP_MAIN_TASK_STACK_SIZE=8192
CONFIG_ESP_SYSTEM_EVENT_TASK_STACK_SIZE=4096

CONFIG_FREERTOS_HZ=1000

CONFIG_LWIP_TCP_SND_BUF_DEFAULT=5760
CONFIG_LWIP_TCP_WND_DEFAULT=5760
CONFIG_LWIP_TCP_RECVMBOX_SIZE=6
CONFIG_LWIP_UDP_RECVMBOX_SIZE=6
CONFIG_LWIP_TCPIP_RECVMBOX_SIZE=64

# Since we use esp_video, which needs latest I2C driver
CONFIG_CODEC_I2C_BACKWARD_COMPATIBLE=n

#
# MDNS Memory Configuration
#
CONFIG_MDNS_TASK_CREATE_FROM_SPIRAM=y
CONFIG_MDNS_MEMORY_ALLOC_SPIRAM=y

#
# esp-video and isp config
#
CONFIG_ESP_VIDEO_ENABLE_ISP_VIDEO_DEVICE=y
CONFIG_ESP_VIDEO_ENABLE_ISP_PIPELINE_CONTROLLER=y
CONFIG_ISP_PIPELINE_CONTROLLER_TASK_STACK_USE_PSRAM=y
```

## esp_port/examples/esp_camera/sdkconfig.defaults.esp32s3
```kconfig
# Defaults for ESP32S3

CONFIG_ESP32S3_DEFAULT_CPU_FREQ_240=y
CONFIG_ESP32S3_DEFAULT_CPU_FREQ_MHZ=240

#
# Serial flasher config
#
CONFIG_ESPTOOLPY_FLASHMODE_QIO=y
CONFIG_ESPTOOLPY_FLASHFREQ_80M=y

CONFIG_ESP32S3_SPIRAM_SUPPORT=y
CONFIG_SPIRAM_MODE_OCT=y

CONFIG_SPIRAM_MALLOC_ALWAYSINTERNAL=0

#
# ESP32-S3-EYE console
#
CONFIG_ESP_CONSOLE_USB_SERIAL_JTAG=y
CONFIG_ESP_CONSOLE_SECONDARY_NONE=y
CONFIG_ESP_CONSOLE_USB_SERIAL_JTAG_ENABLED=y

#
# Cache config
#
CONFIG_ESP32S3_INSTRUCTION_CACHE_32KB=y
CONFIG_ESP32S3_INSTRUCTION_CACHE_SIZE=0x8000
CONFIG_ESP32S3_DATA_CACHE_64KB=y
CONFIG_ESP32S3_DATA_CACHE_SIZE=0x10000

#
# Camera Configuration
#
CONFIG_CAMERA_MODULE_ESP_S3_EYE=y
CONFIG_CAMERA_DMA_BUFFER_SIZE_MAX=16384

#
# GDB Stub
#
CONFIG_ESP_GDBSTUB_ENABLED=y
CONFIG_ESP_SYSTEM_PANIC_GDBSTUB=y
```

## esp_port/examples/network_adapter/sdkconfig.defaults
```kconfig
# BT Configuration
CONFIG_BT_ENABLED=y
CONFIG_BT_CONTROLLER_ONLY=y
CONFIG_NW_COPROC_BT_ENABLED=y

CONFIG_ESP32_WIFI_NVS_ENABLED=

# OTA
CONFIG_ESPTOOLPY_FLASHSIZE_4MB=y
CONFIG_PARTITION_TABLE_TWO_OTA=y

# OS
CONFIG_FREERTOS_HZ=1000

# Enable network only capabilities
CONFIG_ADAPTER_ONLY_MODE=y
```

## esp_port/examples/network_adapter/sdkconfig.defaults.esp32
```kconfig
CONFIG_ESP32_DEFAULT_CPU_FREQ_240=y
CONFIG_SDIO_DAT2_DISABLED=

# BT Configuration
CONFIG_BT_ENABLED=y
CONFIG_BT_CONTROLLER_ONLY=y
CONFIG_NW_COPROC_BT_ENABLED=y

CONFIG_ESP32_WIFI_NVS_ENABLED=

# BT over UART
#CONFIG_BTDM_CONTROLLER_HCI_MODE_UART_H4=y
#CONFIG_BTDM_CTRL_HCI_MODE_UART_H4=y
#CONFIG_BT_HCI_UART_NO=1
#CONFIG_BT_HCI_UART_BAUDRATE=921600

#CO-EX config
CONFIG_FREERTOS_UNICORE=n
CONFIG_ESP32_WIFI_TASK_PINNED_TO_CORE_1=y
CONFIG_BTDM_CONTROLLER_PINNED_TO_CORE=0
CONFIG_BTDM_CTRL_PINNED_TO_CORE=0
CONFIG_BTDM_CTRL_PINNED_TO_CORE_0=y

CONFIG_ESP32_WIFI_STATIC_RX_BUFFER_NUM=16
CONFIG_ESP32_WIFI_DYNAMIC_RX_BUFFER_NUM=32
CONFIG_ESP32_WIFI_DYNAMIC_TX_BUFFER=y
CONFIG_ESP32_WIFI_DYNAMIC_TX_BUFFER_NUM=64

# OTA
CONFIG_ESPTOOLPY_FLASHSIZE_4MB=y
CONFIG_PARTITION_TABLE_TWO_OTA=y
```

## esp_port/examples/network_adapter/sdkconfig.defaults.esp32c2
```kconfig
CONFIG_ESP_DEFAULT_CPU_FREQ_MHZ_120=y
CONFIG_SDIO_DAT2_DISABLED=

# BT Configuration
CONFIG_BT_ENABLED=y
CONFIG_BT_CONTROLLER_ONLY=y
CONFIG_NW_COPROC_BT_ENABLED=y

#UART pins, Enable below config, delete sdkconfig and rebuild
#CONFIG_BT_LE_HCI_INTERFACE_USE_UART=y
#CONFIG_BT_LE_HCI_UART_FLOWCTRL=n
#CONFIG_BT_LE_HCI_UART_TX_PIN=5
#CONFIG_BT_LE_HCI_UART_RX_PIN=18

CONFIG_ESP32_WIFI_NVS_ENABLED=

CONFIG_ESPTOOLPY_FLASHSIZE_4MB=n
CONFIG_ESPTOOLPY_FLASHSIZE_2MB=y
CONFIG_PARTITION_TABLE_TWO_OTA=y
CONFIG_PARTITION_TABLE_CUSTOM=y
CONFIG_PARTITION_TABLE_CUSTOM_FILENAME="partitions.esp32c2.csv"
CONFIG_PARTITION_TABLE_FILENAME="partitions.esp32c2.csv"

CONFIG_ESP_DEFAULT_TASK_STACK_SIZE=2048
```

## esp_port/examples/network_adapter/sdkconfig.defaults.esp32c3
```kconfig
CONFIG_ESP_DEFAULT_CPU_FREQ_MHZ_160=y
CONFIG_SDIO_DAT2_DISABLED=

# BT Configuration
CONFIG_BT_ENABLED=y
CONFIG_BT_CONTROLLER_ONLY=y
CONFIG_BT_BLUEDROID_ENABLED=
CONFIG_BTDM_CTRL_MODE_BLE_ONLY=y
CONFIG_BTDM_CTRL_MODE_BR_EDR_ONLY=n
CONFIG_BTDM_CTRL_MODE_BTDM=n
CONFIG_BTDM_CTRL_HCI_MODE_VHCI=y

CONFIG_ESP32_WIFI_NVS_ENABLED=
```

## esp_port/examples/network_adapter/sdkconfig.defaults.esp32c5
```kconfig
CONFIG_ESP_DEFAULT_CPU_FREQ_MHZ_160=y

# BT Configuration
CONFIG_BT_ENABLED=y
CONFIG_BT_CONTROLLER_ONLY=y
CONFIG_NW_COPROC_BT_ENABLED=y

# SPI/SDIO only
CONFIG_BT_LE_HCI_INTERFACE_USE_RAM=y

# BLE over UART:
# Enable below config, delete sdkconfig, build/ and rebuild
# CONFIG_BT_LE_HCI_INTERFACE_USE_UART=y
# CONFIG_BT_LE_HCI_UART_TX_PIN=5
# CONFIG_BT_LE_HCI_UART_RX_PIN=12
# CONFIG_BT_LE_HCI_UART_FLOWCTRL=n

CONFIG_ESP_WIFI_NVS_ENABLED=

CONFIG_ESP_CACHE_MALLOC=n

CONFIG_PARTITION_TABLE_CUSTOM=y
CONFIG_PARTITION_TABLE_CUSTOM_FILENAME="partitions.esp32c5.csv"
CONFIG_ESP_PKT_STATS=y
# CONFIG_ESP_SDIO_NSEND_PSAMPLE=y
# CONFIG_ESP_SDIO_DEFAULT_SPEED=y
# CONFIG_ESP_SDIO_STREAMING_MODE=n

#CONFIG_ESP_SDIO_CHECKSUM=y
#CONFIG_HEAP_POISONING_COMPREHENSIVE=y
#CONFIG_FREERTOS_GENERATE_RUN_TIME_STATS=y
```

## esp_port/examples/signaling_only/sdkconfig.defaults
```kconfig
# Signaling only module defaults to ESP32C6
CONFIG_IDF_TARGET="esp32c6"
CONFIG_IDF_TARGET_ESP32C6=y

# Define component-specific flag
CONFIG_ENABLE_SIGNALLING_ONLY=y

#
# Serial flasher config
#
CONFIG_ESPTOOLPY_FLASHMODE_QIO=y
CONFIG_ESPTOOLPY_FLASHFREQ_80M=y
CONFIG_ESPTOOLPY_FLASHSIZE_4MB=y

#
# Partition Table
#
CONFIG_PARTITION_TABLE_CUSTOM=y
CONFIG_PARTITION_TABLE_CUSTOM_FILENAME="partitions.csv"
CONFIG_PARTITION_TABLE_FILENAME="partitions.csv"
CONFIG_PARTITION_TABLE_OFFSET=0x8000

#
# SNTP
#
CONFIG_LWIP_SNTP_MAX_SERVERS=3

CONFIG_LWIP_DHCP_MAX_NTP_SERVERS=1

# AWS IoT Core support
CONFIG_IOT_CORE_ENABLE_CREDENTIALS=y

#
# ESP32-Specific
#
CONFIG_ESP32_DEFAULT_CPU_FREQ_240=y
CONFIG_ESP32_DEFAULT_CPU_FREQ_MHZ=240

#
# SPI RAM config
#
CONFIG_SPIRAM=y
CONFIG_SPIRAM_SUPPORT=y
CONFIG_ESP32_SPIRAM_SUPPORT=y
CONFIG_WIFI_LWIP_ALLOCATION_FROM_SPIRAM_FIRST=y

CONFIG_SPIRAM_USE_MALLOC=y
CONFIG_SPIRAM_MALLOC_ALWAYSINTERNAL=0
CONFIG_SPIRAM_TRY_ALLOCATE_WIFI_LWIP=y
CONFIG_SPIRAM_MALLOC_RESERVE_INTERNAL=32768
CONFIG_SPIRAM_ALLOW_BSS_SEG_EXTERNAL_MEMORY=y
CONFIG_SPIRAM_BANKSWITCH_ENABLE=y
CONFIG_SPIRAM_BANKSWITCH_RESERVE=8
CONFIG_SPIRAM_ALLOW_STACK_EXTERNAL_MEMORY=y
CONFIG_SPIRAM_SPEED_80M=y

CONFIG_ESP32_WIFI_STATIC_TX_BUFFER=y
CONFIG_ESP32_WIFI_TX_BUFFER_TYPE=0
CONFIG_ESP32_WIFI_STATIC_TX_BUFFER_NUM=16

CONFIG_LOG_DEFAULT_LEVEL=3

CONFIG_MBEDTLS_EXTERNAL_MEM_ALLOC=y

CONFIG_MBEDTLS_SSL_PROTO_DTLS=y
CONFIG_MBEDTLS_SSL_ALPN=y

# fix build issues on idf master
# CONFIG_MBEDTLS_X509_CREATE_C=y
# CONFIG_MBEDTLS_SSL_DTLS_SRTP=y

#
# FreeRTOS
#
CONFIG_FREERTOS_PLACE_FUNCTIONS_INTO_FLASH=y
CONFIG_FREERTOS_PLACE_SNAPSHOT_FUNS_INTO_FLASH=y

#
# ESP Ringbuf
#
CONFIG_RINGBUF_PLACE_FUNCTIONS_INTO_FLASH=y
CONFIG_RINGBUF_PLACE_ISR_FUNCTIONS_INTO_FLASH=y

#
# ESP System Settings
#
CONFIG_ESP_SYSTEM_ALLOW_RTC_FAST_MEM_AS_HEAP=y

#
# PThreads
#
CONFIG_PTHREAD_TASK_STACK_SIZE_DEFAULT=8000
CONFIG_PTHREAD_STACK_MIN=4096

CONFIG_MAIN_TASK_STACK_SIZE=8192
CONFIG_IPC_TASK_STACK_SIZE=1024
CONFIG_TIMER_TASK_STACK_SIZE=3584

CONFIG_MB_SERIAL_TASK_STACK_SIZE=2048
CONFIG_SUPPORT_STATIC_ALLOCATION=y

#
# Wi-Fi
#
CONFIG_ESP32_WIFI_IRAM_OPT=n
CONFIG_ESP32_WIFI_RX_IRAM_OPT=n

CONFIG_ESP_SYSTEM_EVENT_TASK_STACK_SIZE=4000

# mbedtls dynamic buffer for memory optimization
CONFIG_MBEDTLS_ASYMMETRIC_CONTENT_LEN=y

CONFIG_MBEDTLS_SSL_VARIABLE_BUFFER_LENGTH=n
CONFIG_MBEDTLS_DYNAMIC_BUFFER=y
CONFIG_MBEDTLS_DYNAMIC_FREE_CONFIG_DATA=y
CONFIG_MBEDTLS_DYNAMIC_FREE_CA_CERT=y
CONFIG_MBEDTLS_DYNAMIC_FREE_PEER_CERT=y

CONFIG_ESP_MAIN_TASK_STACK_SIZE=8192
CONFIG_ESP_SYSTEM_EVENT_TASK_STACK_SIZE=4096

CONFIG_FREERTOS_HZ=1000

CONFIG_LWIP_TCP_SND_BUF_DEFAULT=5760
CONFIG_LWIP_TCP_WND_DEFAULT=5760
CONFIG_LWIP_TCP_RECVMBOX_SIZE=6
CONFIG_LWIP_UDP_RECVMBOX_SIZE=6
CONFIG_LWIP_TCPIP_RECVMBOX_SIZE=64

#
# Websockets
#
CONFIG_WS_BUFFER_SIZE=2048
CONFIG_WS_DYNAMIC_BUFFER=y

# Additional WebRTC configs
CONFIG_ENABLE_DATA_CHANNEL=n

#
# ESP-Hosted - Network coprocessor
#
CONFIG_SLAVE_LWIP_ENABLED=y
```

## esp_port/examples/signaling_only/sdkconfig.defaults.esp32c5
```kconfig
# 1. CPU
#--------
CONFIG_ESP_DEFAULT_CPU_FREQ_MHZ_240=y

# 2. BT Configuration
#---------------------
CONFIG_BT_ENABLED=y
CONFIG_BT_CONTROLLER_ONLY=y
CONFIG_BT_BLUEDROID_ENABLED=
CONFIG_BT_LE_SLEEP_ENABLE=y

# 3.1 BLE over SPI/SDIO
#-----------------------
CONFIG_BT_LE_HCI_INTERFACE_USE_RAM=y

# 3.2 BLE over UART
#-------------------
# Enable below config, delete sdkconfig, build/ and rebuild
# CONFIG_BT_LE_HCI_INTERFACE_USE_UART=y
# CONFIG_BT_LE_HCI_UART_TX_PIN=5
# CONFIG_BT_LE_HCI_UART_RX_PIN=18
# CONFIG_BT_LE_HCI_UART_FLOWCTRL=n
# #CONFIG_BT_LE_HCI_UART_RTS_PIN=19
# #CONFIG_BT_LE_HCI_UART_CTS_PIN=8


# 4. Partition Table
#--------------------
# CONFIG_PARTITION_TABLE_OFFSET=0xc000
# CONFIG_PARTITION_TABLE_CUSTOM=y
# CONFIG_PARTITION_TABLE_CUSTOM_FILENAME="partitions.esp32c5.csv"

# 5. Mempool
#------------
CONFIG_ESP_CACHE_MALLOC=y


# 6. Examples
#-------------------------


# 7. Transport config
#---------------------
# CONFIG_ESP_SDIO_NSEND_PSAMPLE=y
# CONFIG_ESP_SDIO_DEFAULT_SPEED=y
# CONFIG_ESP_SDIO_STREAMING_MODE=n


# 8. Wifi config
#----------------
CONFIG_WIFI_CMD_BASIC_ONLY=y

CONFIG_ESP_WIFI_STATIC_RX_BUFFER_NUM=10
CONFIG_ESP_WIFI_DYNAMIC_RX_BUFFER_NUM=32
CONFIG_ESP_WIFI_DYNAMIC_TX_BUFFER_NUM=32
CONFIG_ESP_WIFI_AMPDU_TX_ENABLED=y
CONFIG_ESP_WIFI_TX_BA_WIN=16
CONFIG_ESP_WIFI_AMPDU_RX_ENABLED=y
CONFIG_ESP_WIFI_RX_BA_WIN=16

CONFIG_ESP_WIFI_RX_IRAM_OPT=y
CONFIG_ESP_WIFI_IRAM_OPT=y

# 9. LWIP config
#----------------
CONFIG_LWIP_TCP_SND_BUF_DEFAULT=11520
CONFIG_LWIP_TCP_WND_DEFAULT=11520
CONFIG_LWIP_TCP_RECVMBOX_SIZE=16
CONFIG_LWIP_UDP_RECVMBOX_SIZE=16
CONFIG_LWIP_TCPIP_RECVMBOX_SIZE=32
CONFIG_LWIP_TCP_SACK_OUT=y
CONFIG_LWIP_TCPIP_CORE_LOCKING=y
CONFIG_LWIP_TCPIP_CORE_LOCKING_INPUT=y

# 10. Optimizations
#-------------------
CONFIG_COMPILER_OPTIMIZATION_PERF=y
CONFIG_ESPTOOLPY_FLASHMODE_QIO=y
CONFIG_ESPTOOLPY_FLASHFREQ_80M=y


# 11. Stats
#-----------
#CONFIG_ESP_HOSTED_FUNCTION_PROFILING=y
CONFIG_ESP_PKT_STATS=y

# 12. Priorities
#----------------
CONFIG_IPERF_TRAFFIC_TASK_PRIORITY=18
CONFIG_IPERF_REPORT_TASK_PRIORITY=18


#13. Mem optimizations
#---------------------
CONFIG_FREERTOS_PLACE_FUNCTIONS_INTO_FLASH=y

#
# ESP-Hosted - Network coprocessor
#
CONFIG_SLAVE_LWIP_ENABLED=y
CONFIG_ESP_SDIO_RX_Q_SIZE=10
```

## esp_port/examples/signaling_only/sdkconfig.defaults.esp32c6
```kconfig
# Additional optimizations for ESP32-C6
CONFIG_COMPILER_OPTIMIZATION_SIZE=y

# SPI Configuration
CONFIG_SPI_MASTER_ISR_IN_IRAM=n
CONFIG_SPI_SLAVE_ISR_IN_IRAM=n

# SPI Flash driver
CONFIG_SPI_FLASH_ROM_DRIVER_PATCH=n
CONFIG_SPI_FLASH_ROM_IMPL=y

# Peripheral Control
CONFIG_PERIPH_CTRL_FUNC_IN_IRAM=n

# Event Loop Library
CONFIG_ESP_EVENT_POST_FROM_ISR=n

#
# Wi-Fi
#
CONFIG_ESP_WIFI_IRAM_OPT=n
CONFIG_ESP_WIFI_RX_IRAM_OPT=n
CONFIG_ESP_WIFI_EXTRA_IRAM_OPT=n
CONFIG_ESP_WIFI_SLP_IRAM_OPT=n

#
# ESP-Hosted - Network coprocessor
#
CONFIG_SLAVE_LWIP_ENABLED=y
CONFIG_ESP_SDIO_RX_Q_SIZE=10
```

## esp_port/examples/streaming_only/main/Kconfig.projbuild
```kconfig
menu "Example Configuration"

    config EXAMPLE_ENABLE_POWER_SAVE
        bool "Enable automatic deep sleep power save"
        default y if IDF_TARGET_ESP32P4
        default n
        help
            Enable automatic deep sleep timer management based on WebRTC peer connections.
            When enabled, the device will automatically enter deep sleep after all peer
            connections are closed and no activity is detected for a configured timeout.

            This feature is only available for ESP32-P4 target.

endmenu
```
