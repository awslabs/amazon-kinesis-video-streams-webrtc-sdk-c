## esp_port/examples/streaming_only/sdkconfig.defaults
```kconfig
# Streaming only defaults to P4
CONFIG_IDF_TARGET="esp32p4"
CONFIG_IDF_TARGET_ESP32P4=y

#
# Serial flasher config
#
CONFIG_ESPTOOLPY_FLASHMODE_QIO=y
CONFIG_ESPTOOLPY_FLASHFREQ_80M=y
CONFIG_ESPTOOLPY_FLASHSIZE_4MB=y

#
# Partition Table
#
CONFIG_PARTITION_TABLE_CUSTOM=y
CONFIG_PARTITION_TABLE_CUSTOM_FILENAME="partitions.csv"
CONFIG_PARTITION_TABLE_FILENAME="partitions.csv"
CONFIG_PARTITION_TABLE_OFFSET=0x8000

#
# Example Configuration
#
CONFIG_ESP_WIFI_SSID="myssid"
CONFIG_ESP_WIFI_PASSWORD="mypassword"
CONFIG_ESP_MAXIMUM_RETRY=5
CONFIG_EXAMPLE_SDMMC_BUS_WIDTH_1=y
CONFIG_EXAMPLE_PIN_CMD=35
CONFIG_EXAMPLE_PIN_CLK=36
CONFIG_EXAMPLE_PIN_D0=37

#
# ESP32-Specific
#
CONFIG_ESP32_DEFAULT_CPU_FREQ_240=y
CONFIG_ESP32_DEFAULT_CPU_FREQ_MHZ=240

#
# SPI RAM config
#
CONFIG_SPIRAM=y
CONFIG_SPIRAM_SUPPORT=y
CONFIG_ESP32_SPIRAM_SUPPORT=y
CONFIG_WIFI_LWIP_ALLOCATION_FROM_SPIRAM_FIRST=y

CONFIG_SPIRAM_USE_MALLOC=y
CONFIG_SPIRAM_MALLOC_ALWAYSINTERNAL=0
CONFIG_SPIRAM_TRY_ALLOCATE_WIFI_LWIP=y
CONFIG_SPIRAM_MALLOC_RESERVE_INTERNAL=32768
CONFIG_SPIRAM_ALLOW_BSS_SEG_EXTERNAL_MEMORY=y
CONFIG_SPIRAM_BANKSWITCH_ENABLE=y
CONFIG_SPIRAM_BANKSWITCH_RESERVE=8
CONFIG_SPIRAM_ALLOW_STACK_EXTERNAL_MEMORY=y
CONFIG_SPIRAM_SPEED_80M=y

CONFIG_ESP32_WIFI_STATIC_TX_BUFFER=y
CONFIG_ESP32_WIFI_TX_BUFFER_TYPE=0
CONFIG_ESP32_WIFI_STATIC_TX_BUFFER_NUM=16

CONFIG_FATFS_LFN_HEAP=y
CONFIG_FATFS_MAX_LFN=255
CONFIG_FATFS_API_ENCODING_ANSI_OEM=y
CONFIG_FATFS_FS_LOCK=10

CONFIG_FATFS_ALLOC_PREFER_EXTRAM=y

CONFIG_LOG_DEFAULT_LEVEL=3

#
# SNTP
#
CONFIG_LWIP_SNTP_MAX_SERVERS=3

#CONFIG_LWIP_SO_LINGER=y
#CONFIG_LWIP_SO_RCVBUF=y
#CONFIG_LWIP_NETBUF_RECVINFO=y
#CONFIG_LWIP_IP_FRAG=y
#CONFIG_LWIP_STATS=y

#CONFIG_LWIP_MULTICAST_PING=y
#CONFIG_LWIP_BROADCAST_PING=y

CONFIG_LWIP_DHCP_MAX_NTP_SERVERS=1

CONFIG_MBEDTLS_EXTERNAL_MEM_ALLOC=y

CONFIG_MBEDTLS_DEBUG=y
CONFIG_MBEDTLS_DEBUG_LEVEL_DEBUG=y
CONFIG_MBEDTLS_DEBUG_LEVEL=3

#CONFIG_SEMIHOSTFS_MAX_MOUNT_POINTS=1
#CONFIG_SEMIHOSTFS_HOST_PATH_MAX_LEN=128

CONFIG_MBEDTLS_SSL_PROTO_DTLS=y
CONFIG_MBEDTLS_SSL_ALPN=y

# Some issues when working with libwebsockets
CONFIG_MBEDTLS_ASYMMETRIC_CONTENT_LEN=n

#
# ESP Ringbuf
#
#CONFIG_RINGBUF_PLACE_FUNCTIONS_INTO_FLASH=y
#CONFIG_RINGBUF_PLACE_ISR_FUNCTIONS_INTO_FLASH=y

#
# FreeRTOS
#
CONFIG_FREERTOS_PLACE_SNAPSHOT_FUNS_INTO_FLASH=y

#
# ESP System Settings
#
CONFIG_ESP_SYSTEM_ALLOW_RTC_FAST_MEM_AS_HEAP=y

#
# PThreads
#
CONFIG_PTHREAD_TASK_STACK_SIZE_DEFAULT=8000
CONFIG_PTHREAD_STACK_MIN=4096


CONFIG_MAIN_TASK_STACK_SIZE=12000
CONFIG_IPC_TASK_STACK_SIZE=1024
CONFIG_TIMER_TASK_STACK_SIZE=3584

CONFIG_MB_SERIAL_TASK_STACK_SIZE=2048
CONFIG_SUPPORT_STATIC_ALLOCATION=y

#
# Wi-Fi
#
# CONFIG_ESP32_WIFI_STATIC_RX_BUFFER_NUM=16
CONFIG_ESP32_WIFI_IRAM_OPT=n
CONFIG_ESP32_WIFI_RX_IRAM_OPT=n

CONFIG_ESP_SYSTEM_EVENT_TASK_STACK_SIZE=4000

CONFIG_MBEDTLS_DYNAMIC_BUFFER=y
CONFIG_MBEDTLS_DYNAMIC_FREE_CONFIG_DATA=y
CONFIG_MBEDTLS_DYNAMIC_FREE_CA_CERT=y
CONFIG_MBEDTLS_SSL_VARIABLE_BUFFER_LENGTH=y
CONFIG_MBEDTLS_DYNAMIC_FREE_PEER_CERT=y

CONFIG_ESP_MAIN_TASK_STACK_SIZE=8192
CONFIG_ESP_SYSTEM_EVENT_TASK_STACK_SIZE=4096

CONFIG_FREERTOS_HZ=1000

CONFIG_LWIP_TCP_SND_BUF_DEFAULT=5760
CONFIG_LWIP_TCP_WND_DEFAULT=5760
CONFIG_LWIP_TCP_RECVMBOX_SIZE=6
CONFIG_LWIP_UDP_RECVMBOX_SIZE=6
CONFIG_LWIP_TCPIP_RECVMBOX_SIZE=64

CONFIG_ESP_WEBRTC_BRIDGE_HOSTED=y

# Since we use esp_video, which needs latest I2C driver
CONFIG_CODEC_I2C_BACKWARD_COMPATIBLE=n


#
# ESP-Hosted : Host component
#
CONFIG_SLAVE_LWIP_ENABLED=y
```

## esp_port/examples/streaming_only/sdkconfig.defaults.esp32p4
```kconfig
CONFIG_IDF_EXPERIMENTAL_FEATURES=y

#
# Serial flasher config
#
CONFIG_ESPTOOLPY_FLASHSIZE_8MB=y

#
# ESP System Settings
#
CONFIG_ESP_DEFAULT_CPU_FREQ_MHZ=360
CONFIG_ESP_DEFAULT_CPU_FREQ_MHZ_360=y

#
# ESP NETIF Adapter
#
CONFIG_ESP_NETIF_IP_LOST_TIMER_INTERVAL=120
CONFIG_ESP_NETIF_TCPIP_LWIP=y
# CONFIG_ESP_NETIF_LOOPBACK is not set
CONFIG_ESP_NETIF_USES_TCPIP_WITH_BSD_API=y

#
# ESP PSRAM
#
CONFIG_SPIRAM_MODE_HEX=y
CONFIG_SPIRAM_SPEED_200M=y
CONFIG_SPIRAM_SPEED=200
CONFIG_SPIRAM_ALLOW_BSS_SEG_EXTERNAL_MEMORY=n
CONFIG_SPIRAM_USE_CAPS_ALLOC=y

#
# Cache config
#
CONFIG_CACHE_L2_CACHE_128KB=y
CONFIG_CACHE_L2_CACHE_SIZE=0x20000
CONFIG_CACHE_L2_CACHE_LINE_64B=y
CONFIG_CACHE_L2_CACHE_LINE_SIZE=64
CONFIG_CACHE_L1_CACHE_LINE_SIZE=64

#
# Wi-Fi
#
CONFIG_ESP_WIFI_DYNAMIC_TX_BUFFER=y
CONFIG_ESP_WIFI_TX_BUFFER_TYPE=1
CONFIG_ESP_WIFI_STATIC_RX_BUFFER_NUM=32
CONFIG_ESP_WIFI_DYNAMIC_RX_BUFFER_NUM=80
CONFIG_ESP_WIFI_DYNAMIC_TX_BUFFER_NUM=80

#
# SDIO
#
#CONFIG_ESP_SDIO_OPTIMIZATION_RX_NONE=y
#CONFIG_ESP_SDIO_OPTIMIZATION_RX_MAX_SIZE=y
#CONFIG_ESP_SDIO_OPTIMIZATION_RX_STREAMING_MODE=y
CONFIG_ESP_SDIO_CLOCK_FREQ=40000
#CONFIG_ESP_SDIO_CHECKSUM=y
CONFIG_ESP_PKT_STATS=y

CONFIG_SLAVE_LWIP_ENABLED=y
CONFIG_HOST_USES_STATIC_NETIF=n
#CONFIG_LWIP_TCP_LOCAL_PORT_RANGE_START=49152
#CONFIG_LWIP_TCP_LOCAL_PORT_RANGE_END=61439
#CONFIG_LWIP_UDP_LOCAL_PORT_RANGE_START=49152
#CONFIG_LWIP_UDP_LOCAL_PORT_RANGE_END=61439

#
# Use Hosted lib
#
CONFIG_ESP_WIFI_REMOTE_LIBRARY_HOSTED=y
CONFIG_H2S_WIFI_FLOW_CTRL=n

# For V1.0B board
# CONFIG_BSP_BOARD_TYPE_SAMPLE_V10B=y
# CONFIG_ESP_SDIO_PIN_D0=49
# CONFIG_ESP_SDIO_PIN_D1=50

# For V1.2 Board
CONFIG_BSP_BOARD_TYPE_SAMPLE_V12=y
CONFIG_ESP_SDIO_PIN_D0=14
CONFIG_ESP_SDIO_PIN_D1=15
CONFIG_ESP_CONSOLE_USB_SERIAL_JTAG=y
CONFIG_ESP_CONSOLE_SECONDARY_NONE=y
CONFIG_ESP_CONSOLE_USB_SERIAL_JTAG_ENABLED=y

# Uncomment only one of the camera group of options

CONFIG_CAMERA_SC2336=y
CONFIG_CAMERA_SC2336_AUTO_DETECT=y
CONFIG_CAMERA_SC2336_AUTO_DETECT_MIPI_INTERFACE_SENSOR=y
CONFIG_CAMERA_SC2336_MIPI_RAW8_1920x1080_30FPS=y

# CONFIG_CAMERA_OV5647=y
# CONFIG_CAMERA_OV5647_AUTO_DETECT=y
# CONFIG_CAMERA_OV5647_MIPI_RAW10_1920x1080_30FPS=y
# CONFIG_CAMERA_OV5647_AUTO_DETECT_MIPI_INTERFACE_SENSOR=y
```

## esp_port/examples/webrtc_classic/sdkconfig.defaults.esp32s3
```kconfig
# Defaults for ESP32S3

CONFIG_ESP32S3_DEFAULT_CPU_FREQ_240=y
CONFIG_ESP32S3_DEFAULT_CPU_FREQ_MHZ=240

#
# Serial flasher config
#
CONFIG_ESPTOOLPY_FLASHMODE_QIO=y
CONFIG_ESPTOOLPY_FLASHFREQ_80M=y

CONFIG_ESP32S3_SPIRAM_SUPPORT=y
CONFIG_SPIRAM_MODE_OCT=y

CONFIG_SPIRAM=y
CONFIG_SPIRAM_BOOT_INIT=y

CONFIG_SPIRAM_ALLOW_STACK_EXTERNAL_MEMORY=y
CONFIG_SPIRAM_MALLOC_ALWAYSINTERNAL=0
CONFIG_SPIRAM_TRY_ALLOCATE_WIFI_LWIP=y

#
# ESP32-S3-EYE console
#
CONFIG_ESP_CONSOLE_USB_SERIAL_JTAG=y
CONFIG_ESP_CONSOLE_SECONDARY_NONE=y
CONFIG_ESP_CONSOLE_USB_SERIAL_JTAG_ENABLED=y

#
# Cache config
#
CONFIG_ESP32S3_INSTRUCTION_CACHE_32KB=y
CONFIG_ESP32S3_INSTRUCTION_CACHE_SIZE=0x8000
CONFIG_ESP32S3_DATA_CACHE_64KB=y
CONFIG_ESP32S3_DATA_CACHE_SIZE=0x10000

#
# Reduce Internal memory use
#
CONFIG_SPIRAM_RODATA=y
CONFIG_RINGBUF_PLACE_FUNCTIONS_INTO_FLASH=y
CONFIG_RINGBUF_PLACE_ISR_FUNCTIONS_INTO_FLASH=y
CONFIG_FREERTOS_PLACE_FUNCTIONS_INTO_FLASH=y

#
# Camera Configuration
#
CONFIG_CAMERA_MODULE_ESP_S3_EYE=y
CONFIG_CAMERA_DMA_BUFFER_SIZE_MAX=16384

CONFIG_AWS_DEFAULT_REGION="us-east-1"
CONFIG_SPIRAM_MALLOC_RESERVE_INTERNAL=16000

#
# GDB Stub
#
CONFIG_ESP_GDBSTUB_ENABLED=y
CONFIG_ESP_SYSTEM_PANIC_GDBSTUB=y

CONFIG_FREERTOS_CHECK_STACKOVERFLOW_CANARY=y

CONFIG_SYSTEM_EVENT_TASK_STACK_SIZE=4096
CONFIG_MAIN_TASK_STACK_SIZE=20000
```
