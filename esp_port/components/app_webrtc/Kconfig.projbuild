## esp_port/components/network_coprocessor/sdkconfig.defaults.esp32
```kconfig
CONFIG_ESP32_DEFAULT_CPU_FREQ_240=y
CONFIG_ESP32_DEFAULT_CPU_FREQ_MHZ=240
CONFIG_SDIO_DAT2_DISABLED=

# BT Configuration
CONFIG_BT_ENABLED=y
CONFIG_BT_CONTROLLER_ONLY=y
CONFIG_BT_BLUEDROID_ENABLED=
CONFIG_BTDM_CONTROLLER_MODE_BTDM=y
CONFIG_BTDM_CONTROLLER_HCI_MODE_VHCI=y
CONFIG_BTDM_CTRL_AUTO_LATENCY=y
CONFIG_BTDM_CONTROLLER_MODEM_SLEEP=y
CONFIG_BTDM_CTRL_MODEM_SLEEP=y

# BT over UART
#CONFIG_BTDM_CONTROLLER_HCI_MODE_UART_H4=y
#CONFIG_BTDM_CTRL_HCI_MODE_UART_H4=y
#CONFIG_BT_HCI_UART_NO=1
#CONFIG_BT_HCI_UART_BAUDRATE=921600

#CO-EX config
CONFIG_FREERTOS_UNICORE=n
CONFIG_FREERTOS_HZ=400
CONFIG_ESP32_WIFI_TASK_PINNED_TO_CORE_1=y
CONFIG_BTDM_CONTROLLER_PINNED_TO_CORE=0
CONFIG_BTDM_CTRL_PINNED_TO_CORE=0
CONFIG_BTDM_CTRL_PINNED_TO_CORE_0=y

CONFIG_ESP32_WIFI_STATIC_RX_BUFFER_NUM=16
CONFIG_ESP32_WIFI_DYNAMIC_RX_BUFFER_NUM=32
CONFIG_ESP32_WIFI_DYNAMIC_TX_BUFFER=y
CONFIG_ESP32_WIFI_DYNAMIC_TX_BUFFER_NUM=64

# OTA
CONFIG_PARTITION_TABLE_CUSTOM=y
CONFIG_PARTITION_TABLE_CUSTOM_FILENAME="partitions.esp32.csv"

# iram text saving
CONFIG_FREERTOS_PLACE_FUNCTIONS_INTO_FLASH=y
```

## esp_port/components/network_coprocessor/sdkconfig.defaults.esp32c2
```kconfig
CONFIG_ESP32_DEFAULT_CPU_FREQ_160=y
CONFIG_ESP32_DEFAULT_CPU_FREQ_MHZ=160
CONFIG_FREERTOS_UNICORE=y
CONFIG_SDIO_DAT2_DISABLED=

# BT Configuration
CONFIG_BT_ENABLED=n ## temporary disable
CONFIG_BT_CONTROLLER_ONLY=y
CONFIG_BT_BLUEDROID_ENABLED=
CONFIG_BT_LE_SLEEP_ENABLE=y

#UART pins, Enable below config, delete sdkconfig and rebuild
#CONFIG_BT_LE_HCI_INTERFACE_USE_UART=y
#CONFIG_BT_LE_HCI_UART_FLOWCTRL=n
#CONFIG_BT_LE_HCI_UART_TX_PIN=5
#CONFIG_BT_LE_HCI_UART_RX_PIN=18

CONFIG_ESPTOOLPY_FLASHSIZE_4MB=n
CONFIG_ESPTOOLPY_FLASHSIZE_2MB=y
CONFIG_PARTITION_TABLE_TWO_OTA=y
CONFIG_PARTITION_TABLE_CUSTOM=y
CONFIG_PARTITION_TABLE_CUSTOM_FILENAME="partitions.esp32c2.csv"
CONFIG_PARTITION_TABLE_FILENAME="partitions.esp32c2.csv"

CONFIG_ESP_DEFAULT_TASK_STACK_SIZE=2048
```

## esp_port/components/network_coprocessor/sdkconfig.defaults.esp32c3
```kconfig
CONFIG_ESP32_DEFAULT_CPU_FREQ_160=y
CONFIG_ESP32_DEFAULT_CPU_FREQ_MHZ=160
CONFIG_FREERTOS_UNICORE=y
CONFIG_SDIO_DAT2_DISABLED=

# BT Configuration
CONFIG_BT_ENABLED=y
CONFIG_BT_CONTROLLER_ONLY=y
CONFIG_BT_BLUEDROID_ENABLED=
CONFIG_BT_LE_SLEEP_ENABLE=y
```

## esp_port/components/network_coprocessor/sdkconfig.defaults.esp32c5
```kconfig
CONFIG_ESP32_DEFAULT_CPU_FREQ_240=y
CONFIG_ESP32_DEFAULT_CPU_FREQ_MHZ=240

# BT Configuration
CONFIG_BT_ENABLED=y
CONFIG_BT_CONTROLLER_ONLY=y
CONFIG_BT_BLUEDROID_ENABLED=
CONFIG_BT_LE_SLEEP_ENABLE=y
CONFIG_PARTITION_TABLE_CUSTOM=y
CONFIG_PARTITION_TABLE_CUSTOM_FILENAME="partitions.esp32c5.csv"
```

## esp_port/components/network_coprocessor/sdkconfig.defaults.esp32c6
```kconfig
CONFIG_ESP_DEFAULT_CPU_FREQ_MHZ_160=y

# BT Configuration
CONFIG_BT_ENABLED=y
CONFIG_BT_CONTROLLER_ONLY=y
CONFIG_BT_BLUEDROID_ENABLED=
CONFIG_BT_LE_SLEEP_ENABLE=y

# SPI/SDIO only
CONFIG_BT_LE_HCI_INTERFACE_USE_RAM=y

# BLE over UART:
# Enable below config, delete sdkconfig, build/ and rebuild
# CONFIG_BT_LE_HCI_INTERFACE_USE_UART=y
# CONFIG_BT_LE_HCI_UART_TX_PIN=5
# CONFIG_BT_LE_HCI_UART_RX_PIN=12
# CONFIG_BT_LE_HCI_UART_FLOWCTRL=n
# # 4 pin solution is not working yet for c6
# #CONFIG_BT_LE_HCI_UART_RTS_PIN=9
# #CONFIG_BT_LE_HCI_UART_CTS_PIN=13

CONFIG_ESP_CACHE_MALLOC=n

CONFIG_PARTITION_TABLE_CUSTOM=y
CONFIG_PARTITION_TABLE_CUSTOM_FILENAME="partitions.esp32c6.csv"
CONFIG_ESP_PKT_STATS=y
```

## esp_port/components/network_coprocessor/sdkconfig.defaults.esp32s3
```kconfig
#For battery sensitive usage, can reduce the CPU frequency
CONFIG_ESP32_DEFAULT_CPU_FREQ_240=y
CONFIG_ESP32_DEFAULT_CPU_FREQ_MHZ=240

# BT Configuration
CONFIG_BT_ENABLED=y
CONFIG_BT_CONTROLLER_ONLY=y
CONFIG_BT_BLUEDROID_ENABLED=
CONFIG_BT_LE_SLEEP_ENABLE=y
```

## esp_port/components/signaling_serializer/Kconfig.projbuild
```kconfig
choice KVS_SERIALIZATION_METHOD
    prompt "Signaling message serialization method"
    default KVS_USE_PROTOBUF_SERIALIZATION
    help
        When WebRTC is used in a split mode, the signaling messages needs to be exchanged between signaling_only and streaming_only applications.
        This requires a serialization/deserialization method that is compatible with both applications.
        Note: The same serialization method should be used for both the signaling and streaming applications.

    config KVS_USE_PROTOBUF_SERIALIZATION
        bool "Protocol Buffers"
        help
            Use Protocol Buffers for signaling message serialization.
            This reduces message size but requires more ROM.

    config KVS_USE_JSON_SERIALIZATION
        bool "JSON"
        help
            Use JSON for signaling message serialization.
            This uses more bandwidth but requires less ROM.

    config KVS_USE_RAW_SERIALIZATION
        bool "Raw"
        help
            Use non-standardraw serialization, i.e. the payload is appended to the signaling message.
            This is the most efficient serialization method but may bump into tricky issues.
endchoice
```

## esp_port/components/webrtc_bridge/Kconfig.projbuild
```kconfig
menu "WebRTC Bridge Config"
    choice WEBRTC_BRIDGE_TYPE
        bool "Bridge to use between streaming and signalling device"
        default ESP_WEBRTC_BRIDGE_HOSTED if IDF_TARGET_ESP32P4
        default ESP_WEBRTC_BRIDGE_HOSTED if IDF_TARGET_ESP32C6
        default ESP_WEBRTC_BRIDGE_HOSTED if IDF_TARGET_ESP32C5
        default ESP_WEBRTC_BRIDGE_MQTT
        help
            Bus interface to be used for communication with the host

        config ESP_WEBRTC_BRIDGE_HOSTED
            bool "Use hosted bridge"
            help
                Relay messages using existing esp_hosted communication line
                Direct dependancy on `ESP_HOSTED_ENABLED`

        config ESP_WEBRTC_BRIDGE_MQTT
            bool "Use MQTT bridge"
            help
                Relay messages using by subscribing and publishing to MQTT broker
    endchoice
endmenu
```

## esp_port/examples/app_common/Kconfig.projbuild
```kconfig
menu "App Common Configs (Wi-Fi, SD-Card, Camera)"
    config APP_COMMON_USE_SPIFFS
        bool "Read certs from SPIFFS"
        default y
        help
            If enabled, default SPIFFS will be considered and flashed
            Disable this option to plug your own file_system partition

    config ESP_WIFI_SSID
        string "WiFi SSID"
        default "myssid"
        help
            SSID (network name) for the example to connect to.

    config ESP_WIFI_PASSWORD
        string "WiFi Password"
        default "mypassword"
        help
            WiFi password (WPA or WPA2) for the example to use.

    config ESP_MAXIMUM_RETRY
        int "Maximum retry"
        default 5
        help
            Set the Maximum retry to avoid station reconnecting to the AP unlimited when the AP is really inexistent.

    config EXAMPLE_FORMAT_IF_MOUNT_FAILED
        bool "Format the card if mount failed"
        default n
        help
            If this config item is set, format_if_mount_failed will be set to true and the card will be formatted if
            the mount has failed.

    choice EXAMPLE_SDMMC_BUS_WIDTH
        prompt "SD/MMC bus width"
        default EXAMPLE_SDMMC_BUS_WIDTH_1
        help
            Select the bus width of SD or MMC interface.
            Note that even if 1 line mode is used, D3 pin of the SD card must have a pull-up resistor connected.
            Otherwise the card may enter SPI mode, the only way to recover from which is to cycle power to the card.

        config EXAMPLE_SDMMC_BUS_WIDTH_4
            bool "4 lines (D0 - D3)"

        config EXAMPLE_SDMMC_BUS_WIDTH_1
            bool "1 line (D0)"
    endchoice

    if IDF_TARGET_ESP32S3

        config EXAMPLE_PIN_CMD
            int "CMD GPIO number"
            default 35 if IDF_TARGET_ESP32S3

        config EXAMPLE_PIN_CLK
            int "CLK GPIO number"
            default 36 if IDF_TARGET_ESP32S3

        config EXAMPLE_PIN_D0
            int "D0 GPIO number"
            default 37 if IDF_TARGET_ESP32S3

        if EXAMPLE_SDMMC_BUS_WIDTH_4

            config EXAMPLE_PIN_D1
                int "D1 GPIO number"
                default 38 if IDF_TARGET_ESP32S3

            config EXAMPLE_PIN_D2
                int "D2 GPIO number"
                default 33 if IDF_TARGET_ESP32S3

            config EXAMPLE_PIN_D3
                int "D3 GPIO number"
                default 34 if IDF_TARGET_ESP32S3

        endif  # EXAMPLE_SDMMC_BUS_WIDTH_4

    endif  # IDF_TARGET_ESP32S3
endmenu

menu "AWS IoT Core Credentials"
    config IOT_CORE_ENABLE_CREDENTIALS
        bool "Enable AWS IoT Core credentials for authentication"
        default y
        help
            Enable this option to use AWS IoT Core credentials for authentication.
            When enabled, the application will use the AWS IoT Core credentials provider
            to obtain temporary credentials for accessing AWS services.
            If disabled, application should set access key instead

    config AWS_IOT_CORE_CREDENTIAL_ENDPOINT
        string "AWS IoT Core Credential Endpoint"
        default "credential-endpoint.credentials.iot.us-east-1.amazonaws.com"
        depends on IOT_CORE_ENABLE_CREDENTIALS
        help
            AWS IoT Core credential endpoint to use for credential provider. This is the endpoint used for the AWS IoT credential provider.

    config AWS_IOT_CORE_CERT
        string "AWS IoT Core Certificate"
        default "/spiffs/certs/iot-certificate.pem.crt"
        depends on IOT_CORE_ENABLE_CREDENTIALS
        help
            Path to the AWS IoT Core certificate file. This certificate is used for authenticating with AWS IoT Core.

    config AWS_IOT_CORE_PRIVATE_KEY
        string "AWS IoT Core Private Key"
        default "/spiffs/certs/iot-private.pem.key"
        depends on IOT_CORE_ENABLE_CREDENTIALS
        help
            Path to the AWS IoT Core private key file. This key is used for authenticating with AWS IoT Core.

    config AWS_IOT_CORE_ROLE_ALIAS
        string "AWS IoT Core Role Alias"
        default "KVS-WebRTC-Role-Alias"
        depends on IOT_CORE_ENABLE_CREDENTIALS
        help
            AWS IoT Core role alias to use for credential provider. This role alias is used to assume a role with the necessary permissions.

    config AWS_IOT_CORE_THING_NAME
        string "AWS IoT Core Thing Name"
        default "ESP32-WebRTC-Camera"
        depends on IOT_CORE_ENABLE_CREDENTIALS
        help
            AWS IoT Core thing name. This identifies your device in AWS IoT Core.

    config AWS_KVS_CHANNEL_NAME
        string "KVS Channel Name"
        default "ESP32Channel"
        help
            The name of the signaling channel to use for WebRTC communication.

    config AWS_ACCESS_KEY_ID
        string "AWS Access Key ID"
        default ""
        depends on !IOT_CORE_ENABLE_CREDENTIALS
        help
            AWS Access Key ID for KVS access. Used when not using IoT Core credentials.

    config AWS_SECRET_ACCESS_KEY
        string "AWS Secret Access Key"
        default ""
        depends on !IOT_CORE_ENABLE_CREDENTIALS
        help
            AWS Secret Access Key for KVS access. Used when not using IoT Core credentials.

    config AWS_DEFAULT_REGION
        string "AWS Region"
        default "us-east-1"
        help
            AWS Region for KVS service.
endmenu
```
